## archive/knob-probe-companion/sdkconfig.defaults
```kconfig
CONFIG_IDF_TARGET="esp32"
CONFIG_ESPTOOLPY_FLASHSIZE_4MB=y
CONFIG_ESPTOOLPY_FLASHSIZE="4MB"
CONFIG_FREERTOS_HZ=1000
```

## firmware/dial-idf-companion/sdkconfig.defaults
```kconfig
# Companion is an ESP32-U4WDH: classic ESP32, 4MB embedded flash, no PSRAM.
CONFIG_ESPTOOLPY_FLASHSIZE_4MB=y
CONFIG_ESPTOOLPY_FLASHSIZE="4MB"
CONFIG_ESP_MAIN_TASK_STACK_SIZE=4096
```

## firmware/dial/target/orion-knob/sdkconfig/sdkconfig.defaults
```kconfig
# orion-knob deltas over the base esp32s3 sdkconfig.
# 16 MB flash (this board) + 8 MB Octal PSRAM (ESP32-S3R8). USB/console left at base.

CONFIG_ESPTOOLPY_FLASHSIZE_16MB=y
CONFIG_ESPTOOLPY_FLASHSIZE="16MB"

CONFIG_SPIRAM=y
CONFIG_SPIRAM_MODE_OCT=y
CONFIG_SPIRAM_SPEED_80M=y
CONFIG_SPIRAM_BOOT_INIT=y
CONFIG_SPIRAM_IGNORE_NOTFOUND=y
CONFIG_SPIRAM_USE_MALLOC=y
```

## firmware/knob-probe/sdkconfig.defaults
```kconfig
CONFIG_IDF_TARGET="esp32s3"
# Console over the native USB (same /dev/cu.usbmodem2101 the dial uses).
CONFIG_ESP_CONSOLE_USB_SERIAL_JTAG=y
CONFIG_ESP_CONSOLE_SECONDARY_NONE=y
CONFIG_ESPTOOLPY_FLASHSIZE_16MB=y
CONFIG_ESPTOOLPY_FLASHSIZE="16MB"
```
